/************************吉光嵌入式技术工作室**************************
项目名称          ：EXTI外部中断的使用
编译环境          ：这部分程序基于MDK4.0编译环境
芯片型号          : STM32F103VET6
程序类型          : 应用类
晶振频率          : 8.000000 MHz
内存模式          : 
外部SRAM大小      : 
数据堆栈大小      : 
***************************************文件信息*************************
文件名            : demo
创建人            : 刘兵	   QQ:492355772   Tel:13721239883
最后修改日期      ：2015年5月26日
描        述      : 
***************************************当前版本信息*********************
创建人            : 刘兵	   QQ:492355772   Tel:13721239883
版  本            : v3.5
日　期            : 2015年6月26日
描　述            : 当前版本
***************************************项目功能描述*********************
创建人            : 刘兵
项目功能描述      : 工程模板
					LED引脚对应引脚如下：LED1-PC.4 LED2-PC.5 LED3-PD.6
					LED4-PD.7
*************************************************************************/
/********公共头文件********/
#include"share.h" 


/********变量定义********/


/********函数声明********/


/*******************************************************************************
函数名称    : main
功能描述    : 完成系统时钟的初始化，调用项目子函数完成4LED流水作业
输入        : None
输出        : None
返回        : None
*******************************************************************************/
int main(void)
{
	RCC_Configuration();	  //RCC初始化
	delay_init(72);
	GPIO_CONFIG();	


	while(1)
	{
	   if(GPIO_ReadInputDataBit(GPIOD, GPIO_Pin_0)==0)
	   {
	     GPIO_SetBits(GPIOD, GPIO_Pin_4);
		 delay_ms(500);
		 GPIO_ResetBits(GPIOD,GPIO_Pin_4);
		 delay_ms(500);
	   }
	}
}

#ifdef  USE_FULL_ASSERT
void assert_failed(uint8_t* file, uint32_t line)
{ 
  /* Infinite loop */
  while (1)
  {
  }
}
#endif


/******************* (C) COPYRIGHT 2015 吉光嵌入式技术工作室********************/
